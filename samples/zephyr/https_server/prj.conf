## CMakeLists.txt
```
# SPDX-License-Identifier: MIT
# Copyright (c) 2026 Cezary Manista

cmake_minimum_required(VERSION 3.20.0)

find_package(Zephyr REQUIRED HINTS $ENV{ZEPHYR_BASE})
project(uchttp_https_server)

target_sources(app PRIVATE src/main.cpp)

# uchttp public headers + the Zephyr socket/TLS port. ZEPHYR_UCHTTP_MODULE_DIR
# is set by Zephyr's module system to the root of the uchttp module.
target_include_directories(app PRIVATE
  ${ZEPHYR_UCHTTP_MODULE_DIR}/include
  ${ZEPHYR_UCHTTP_MODULE_DIR}/src/port/zephyr
  ${ZEPHYR_UCHTTP_MODULE_DIR}/third_party/llhttp/include
)
```

## prj.conf
```kconfig
# uchttp HTTPS server sample — Stage 2 (TLS), with WiFi + shell console.
#
# On FRDM-RW612 connect to WiFi from the console, e.g.:
#   uart:~$ wifi connect -s <SSID> -k 1 -p <PASSWORD>
#   uart:~$ net iface                 # shows the DHCP-assigned IPv4
# then from a host on the same network:
#   curl -k https://<device-ip>:8443/api/hello

# C++ (the core engine is C++23).
CONFIG_CPP=y
CONFIG_STD_CPP23=y
CONFIG_REQUIRES_FULL_LIBCPP=y

# uchttp module + Stage 2 TLS port.
CONFIG_UCHTTP=y
CONFIG_UCHTTP_TLS=y
CONFIG_UCHTTP_MAX_CONNECTIONS=4
CONFIG_UCHTTP_RX_BUFFER_SIZE=1024
CONFIG_UCHTTP_TX_BUFFER_SIZE=1024

# Networking core.
CONFIG_NETWORKING=y
CONFIG_NET_IPV4=y
CONFIG_NET_IPV6=n
CONFIG_NET_TCP=y
CONFIG_NET_SOCKETS=y
CONFIG_POSIX_API=y
CONFIG_NET_DHCPV4=y

# Secure sockets (TLS offload at the socket layer) + credential store.
# CONFIG_UCHTTP_TLS already selects these, listed here for clarity.
CONFIG_NET_SOCKETS_SOCKOPT_TLS=y
CONFIG_TLS_CREDENTIALS=y

# Mbed TLS / PSA Crypto backend.
CONFIG_MBEDTLS=y
CONFIG_MBEDTLS_ENABLE_HEAP=y
CONFIG_MBEDTLS_HEAP_SIZE=60000
CONFIG_MBEDTLS_SSL_IN_CONTENT_LEN=4096
CONFIG_MBEDTLS_SSL_OUT_CONTENT_LEN=4096
# Server-side TLS 1.2 with an RSA certificate.
CONFIG_MBEDTLS_CIPHERSUITE_TLS_ECDHE_RSA_WITH_AES_128_CBC_SHA256=y

# Number of concurrent TLS contexts (must cover the connection pool).
CONFIG_NET_SOCKETS_TLS_MAX_CONTEXTS=6

# WiFi + management.
CONFIG_WIFI=y
CONFIG_NET_L2_WIFI_MGMT=y

# Console + shell so the user can configure the WiFi connection interactively.
CONFIG_CONSOLE=y
CONFIG_SHELL=y
CONFIG_NET_SHELL=y
CONFIG_NET_L2_WIFI_SHELL=y

# net_mgmt event handling (WiFi scan results can be bursty).
CONFIG_NET_MGMT=y
CONFIG_NET_MGMT_EVENT=y
CONFIG_NET_MGMT_EVENT_QUEUE_TIMEOUT=5000
CONFIG_NET_MGMT_EVENT_QUEUE_SIZE=16

# Buffers / connections.
CONFIG_NET_MAX_CONN=8
CONFIG_NET_PKT_RX_COUNT=16
CONFIG_NET_PKT_TX_COUNT=16
CONFIG_NET_BUF_RX_COUNT=64
CONFIG_NET_BUF_TX_COUNT=64

# Stacks — the TLS handshake and Mbed TLS need generous stacks.
CONFIG_MAIN_STACK_SIZE=4096
CONFIG_SHELL_STACK_SIZE=5200

# Logging.
CONFIG_LOG=y
CONFIG_NET_LOG=y
```

## boards/frdm_rw612.conf
```kconfig
# FRDM-RW612 — NXP integrated WiFi (RW610/612). Disables the Ethernet driver
# and enables the on-SoC WiFi so `wifi connect ...` works from the console.
CONFIG_WIFI_NXP=y
CONFIG_NXP_RW610=y
CONFIG_ETH_DRIVER=n

# Stacks tuned for the WiFi management + supplicant workload *and* for TLS.
# With Zephyr native secure sockets the TLS record layer (Mbed TLS) runs in the
# network RX/TX work-queue threads — NOT in the application/server thread — so
# an RSA-2048 handshake overflows the default 1500 B rx_q stack. Give the net
# RX/TX threads generous stacks; this is what fixes the "Stack overflow on
# rx_q[0]" fault during the first request.
CONFIG_NET_RX_STACK_SIZE=8192
CONFIG_NET_TX_STACK_SIZE=4096

CONFIG_SHELL_STACK_SIZE=6144
CONFIG_SYSTEM_WORKQUEUE_STACK_SIZE=4096
CONFIG_NET_MGMT_EVENT_STACK_SIZE=4608
CONFIG_NET_TCP_WORKQ_STACK_SIZE=2048
CONFIG_MAIN_STACK_SIZE=4096
CONFIG_IDLE_STACK_SIZE=1024

# Give Mbed TLS enough heap for an RSA-2048 server handshake on this target.
CONFIG_MBEDTLS_HEAP_SIZE=80000
```

## boards/native_sim.conf
```kconfig
# native_sim host build — swap the WiFi driver (not available on the host) for
# Zephyr's native TAP Ethernet so the TLS server can be exercised on a PC.
# The WiFi shell/supplicant is a hard dependency only on real radios; on the
# host we bring the interface up over a zeth TAP device instead.
CONFIG_WIFI=n
CONFIG_WIFI_NXP=n
CONFIG_NXP_RW610=n
CONFIG_NET_L2_WIFI_MGMT=n
CONFIG_NET_L2_WIFI_SHELL=n

# Native TAP Ethernet (host networking). Configure your zeth interface per the
# Zephyr "Networking with native_sim" docs to reach the server.
CONFIG_ETH_DRIVER=y
CONFIG_ETH_NATIVE_TAP=y
CONFIG_NET_DHCPV4=n
CONFIG_NET_CONFIG_SETTINGS=y
CONFIG_NET_CONFIG_NEED_IPV4=y
CONFIG_NET_CONFIG_MY_IPV4_ADDR="192.0.2.1"
CONFIG_NET_CONFIG_MY_IPV4_NETMASK="255.255.255.0"
```

## boards/frdm_rw612.overlay
```dts
/*
 * FRDM-RW612 overlay for the uchttp WiFi sample.
 * SPDX-License-Identifier: MIT
 * Copyright (c) 2026 Cezary Manista
 */

&standby {
	status = "okay";
};
```

## src/main.cpp
```c
// SPDX-License-Identifier: MIT
// Copyright (c) 2026 Cezary Manista

/*
 * uchttp on Zephyr — Stage 2 example (HTTPS/TLS) with WiFi + shell.
 *
 * Same structure as the Stage 1 HTTP sample, but the server runs over TLS:
 * credentials are registered with uchttp::ZephyrTlsCredentials and the server
 * listens through uchttp::ZephyrTlsAcceptor. The crypto is Zephyr's native TLS
 * (Mbed TLS / PSA Crypto); HttpServer<ZephyrSocket> is unchanged because TLS is
 * transparent at the socket layer.
 *
 * Console session on FRDM-RW612:
 *
 *   uart:~$ wifi connect -s <SSID> -k 1 -p <PASSWORD>
 *   uart:~$ net iface                 # note the DHCP IPv4 address
 *   $ curl -k https://<device-ip>:8443/api/hello
 *
 * -k tells curl to accept the self-signed demo certificate in certificate.h.
 */

#include <cstdio>

#include "uchttp.h"
#include "uchttp_app_middleware.h"
#include "zephyr_socket.h"
#include "zephyr_tls.h"

/* Embedded self-signed server certificate + private key (DEMO ONLY). */
#include "certificate.h"

#include <zephyr/kernel.h>
#include <zephyr/logging/log.h>
#include <zephyr/net/net_if.h>
#include <zephyr/net/net_mgmt.h>
#include <zephyr/net/net_event.h>

LOG_MODULE_REGISTER(uchttp_https_sample, LOG_LEVEL_INF);

namespace {

constexpr uint16_t HTTPS_PORT = 8443;

constexpr size_t  SERVER_STACK_SIZE = 8192;   /* TLS handshake needs headroom */
K_THREAD_STACK_DEFINE(server_stack, SERVER_STACK_SIZE);
k_thread server_thread_data;

void handle_root(const uchttp::HttpRequest & /*req*/, uchttp::HttpResponse &res) {
	res.set_status(200);
	res.set_content_type("text/html");
	res.set_body("<html><body><h1>uchttp on Zephyr (HTTPS)</h1></body></html>");
}

void handle_hello(const uchttp::HttpRequest & /*req*/, uchttp::HttpResponse &res) {
	res.set_status(200);
	res.set_content_type("application/json");
	res.set_body(R"({"message":"Hello over TLS from uchttp on Zephyr!"})");
}

void handle_sensor(const uchttp::HttpRequest &req, uchttp::HttpResponse &res) {
	std::string_view id = req.path_param("id");
	static char buf[96];
	int n = snprintf(buf, sizeof(buf),
			 R"({"sensor":"%.*s","value":23.5})",
			 static_cast<int>(id.size()), id.data());
	res.set_status(200);
	res.set_content_type("application/json");
	res.set_body(std::string_view(buf, static_cast<size_t>(n)));
}

/* Block until the default interface has an IPv4 address (DHCP after the user
 * runs `wifi connect` from the shell). */
void wait_for_ipv4(void)
{
	while (true) {
		net_if *iface = net_if_get_default();
		if (iface != nullptr &&
		    net_if_ipv4_get_global_addr(iface, NET_ADDR_PREFERRED) != nullptr) {
			return;
		}
		k_sleep(K_MSEC(500));
	}
}

bool register_tls_credentials(void)
{
	/* The credential store keeps pointers to these buffers, so they must
	 * outlive every TLS socket — here they are `static const` in flash. */
	if (!uchttp::ZephyrTlsCredentials::add_server_cert(
		    UCHTTP_TLS_SERVER_CERT_TAG,
		    server_certificate, server_certificate_len,
		    private_key,        private_key_len)) {
		LOG_ERR("Failed to register TLS server certificate/key");
		return false;
	}
	return true;
}

void server_thread(void *, void *, void *)
{
	LOG_INF("uchttp: waiting for WiFi/IPv4 "
		"(use `wifi connect -s <SSID> -k 1 -p <PASS>`)");
	wait_for_ipv4();

	if (!register_tls_credentials()) {
		return;
	}

	static uchttp::HttpServer<uchttp::ZephyrSocket> server;
	static uchttp::ZephyrTlsAcceptor acceptor(HTTPS_PORT,
						  UCHTTP_TLS_SERVER_CERT_TAG);

	server.use(uchttp::app::request_id);
	server.get("/",                 handle_root);
	server.get("/api/hello",        handle_hello);
	server.get("/api/sensors/{id}", handle_sensor);

	if (!acceptor.start()) {
		LOG_ERR("Failed to bind/listen (TLS) on port %u", HTTPS_PORT);
		return;
	}
	LOG_INF("uchttp: HTTPS listening on port %u — "
		"curl -k https://<device-ip>:%u/api/hello",
		HTTPS_PORT, HTTPS_PORT);

	server.run(acceptor);   /* blocking accept/serve loop, now over TLS */
}

} // namespace

int main(void)
{
	LOG_INF("uchttp HTTPS WiFi sample. Configure WiFi from the console, then "
		"the TLS server starts automatically.");

	k_thread_create(&server_thread_data, server_stack, SERVER_STACK_SIZE,
			server_thread, nullptr, nullptr, nullptr,
			K_PRIO_PREEMPT(8), 0, K_NO_WAIT);
	k_thread_name_set(&server_thread_data, "uchttp-tls");

	return 0;
}
```

## src/certificate.h
```c
// SPDX-License-Identifier: MIT
// Copyright (c) 2026 Cezary Manista

/*
 * Auto-generated TLS credentials for the uchttp HTTPS sample (DER format).
 * Self-signed (CN=uchttp.local). DEMO ONLY — replace for production.
 *
 * DER is used (not PEM) because many embedded Mbed TLS configs — including
 * the FRDM-RW612 PSA/ELS-PKC build — disable MBEDTLS_PEM_PARSE_C to save
 * flash, so only DER credentials parse. DER arrays carry an exact length
 * (no terminating NUL, unlike PEM).
 *
 * Regenerate:
 *   openssl req -x509 -newkey rsa:2048 -nodes \
 *     -keyout server_key.pem -out server_cert.pem -days 3650 \
 *     -subj '/CN=uchttp.local'
 *   openssl x509 -in server_cert.pem -outform DER -out server_cert.der
 *   openssl pkey -in server_key.pem  -outform DER -out server_key.der
 */
#pragma once

static const unsigned char server_certificate[] = {
  0x30, 0x82, 0x03, 0x0f, 0x30, 0x82, 0x01, 0xf7, 0xa0, 0x03, 0x02, 0x01,
  0x02, 0x02, 0x14, 0x73, 0xd7, 0xfc, 0xf3, 0x95, 0x38, 0x52, 0x02, 0xff,
  0x76, 0xa4, 0x28, 0x63, 0x02, 0x8d, 0x98, 0x70, 0xff, 0x26, 0x90, 0x30,
  0x0d, 0x06, 0x09, 0x2a, 0x86, 0x48, 0x86, 0xf7, 0x0d, 0x01, 0x01, 0x0b,
  0x05, 0x00, 0x30, 0x17, 0x31, 0x15, 0x30, 0x13, 0x06, 0x03, 0x55, 0x04,
  0x03, 0x0c, 0x0c, 0x75, 0x63, 0x68, 0x74, 0x74, 0x70, 0x2e, 0x6c, 0x6f,
  0x63, 0x61, 0x6c, 0x30, 0x1e, 0x17, 0x0d, 0x32, 0x36, 0x31, 0x31, 0x30,
  0x32, 0x31, 0x34, 0x32, 0x37, 0x30, 0x36, 0x5a, 0x17, 0x0d, 0x33, 0x36,
  0x31, 0x30, 0x33, 0x30, 0x31, 0x34, 0x32, 0x37, 0x30, 0x36, 0x5a, 0x30,
  0x17, 0x31, 0x15, 0x30, 0x13, 0x06, 0x03, 0x55, 0x04, 0x03, 0x0c, 0x0c,
  0x75, 0x63, 0x68, 0x74, 0x74, 0x70, 0x2e, 0x6c, 0x6f, 0x63, 0x61, 0x6c,
  0x30, 0x82, 0x01, 0x22, 0x30, 0x0d, 0x06, 0x09, 0x2a, 0x86, 0x48, 0x86,
  0xf7, 0x0d, 0x01, 0x01, 0x01, 0x05, 0x00, 0x03, 0x82, 0x01, 0x0f, 0x00,
  0x30, 0x82, 0x01, 0x0a, 0x02, 0x82, 0x01, 0x01, 0x00, 0xe8, 0xb5, 0x25,
  0x89, 0xc4, 0xc1, 0x6f, 0x65, 0x7d, 0x02, 0xbc, 0xf8, 0x12, 0xa8, 0xf6,
  0x26, 0x54, 0xc3, 0x16, 0x74, 0xe8, 0x15, 0x54, 0x90, 0x4b, 0x43, 0x18,
  0x69, 0xa5, 0x2c, 0x3b, 0xe7, 0x27, 0xf6, 0x0a, 0x1e, 0xf8, 0x05, 0x6d,
  0x91, 0x5c, 0xc7, 0x80, 0xab, 0x9f, 0xf4, 0x1f, 0x79, 0xb1, 0xf0, 0x01,
  0xaf, 0x61, 0xdc, 0xaf, 0x29, 0x7e, 0x7e, 0x4f, 0x5d, 0xe3, 0x3f, 0x1c,
  0xba, 0xc7, 0x1c, 0x8f, 0xf4, 0xe9, 0x26, 0xbc, 0x8d, 0x39, 0x86, 0x0b,
  0xf9, 0x5c, 0xa9, 0xb6, 0xbf, 0xe8, 0x99, 0x91, 0xeb, 0x64, 0xdd, 0xff,
  0x01, 0x8e, 0x4e, 0xa5, 0x5a, 0xf5, 0x97, 0x15, 0x9d, 0x73, 0x11, 0x93,
  0xc7, 0x8b, 0xad, 0x09, 0x94, 0x4a, 0xf8, 0x40, 0xbc, 0x44, 0x00, 0x68,
  0xe1, 0xbf, 0x6a, 0x84, 0x7a, 0x11, 0x78, 0x80, 0x59, 0x0d, 0x53, 0x83,
  0x77, 0x7e, 0x62, 0x79, 0xe4, 0xdc, 0x5f, 0x61, 0xa9, 0xa9, 0x3a, 0xd6,
  0x64, 0xa0, 0xc0, 0x12, 0x4a, 0x4b, 0xfc, 0x12, 0x0d, 0x61, 0x42, 0x2a,
  0xc7, 0x47, 0xb3, 0x49, 0x8f, 0x73, 0xf3, 0xfb, 0xd3, 0xd1, 0x59, 0xb3,
  0x46, 0x29, 0x37, 0xc8, 0xc5, 0x14, 0x1c, 0x6e, 0xb8, 0x0a, 0x87, 0x95,
  0xff, 0xa4, 0x4a, 0x0e, 0x23, 0x48, 0xdf, 0xd6, 0x88, 0x9c, 0xee, 0xfc,
  0xf4, 0x2b, 0xcd, 0x93, 0x7f, 0x0e, 0xb7, 0xb9, 0x85, 0x43, 0xf6, 0xc2,
  0x8f, 0x75, 0xdd, 0xfe, 0x08, 0x72, 0x30, 0x2e, 0x27, 0x5f, 0xbf, 0xf4,
  0x2d, 0x6e, 0xaf, 0x17, 0x72, 0x85, 0x83, 0x0c, 0x2f, 0x26, 0x48, 0x59,
  0xa7, 0xae, 0xf7, 0xd8, 0xaf, 0xc0, 0x10, 0x25, 0xfd, 0x02, 0x19, 0xef,
  0x04, 0xfd, 0x27, 0xe3, 0xa0, 0xc2, 0xb1, 0xe4, 0x59, 0x6c, 0x1a, 0x1d,
  0xed, 0x41, 0x5c, 0x15, 0xd0, 0x56, 0xad, 0xad, 0x7d, 0xf7, 0x9a, 0x6b,
  0x73, 0x02, 0x03, 0x01, 0x00, 0x01, 0xa3, 0x53, 0x30, 0x51, 0x30, 0x1d,
  0x06, 0x03, 0x55, 0x1d, 0x0e, 0x04, 0x16, 0x04, 0x14, 0x4b, 0xec, 0xf9,
  0x1a, 0xe9, 0x3a, 0xa9, 0xbf, 0x83, 0x40, 0x7b, 0x3f, 0xe0, 0x29, 0x86,
  0xbd, 0x37, 0x38, 0x57, 0x90, 0x30, 0x1f, 0x06, 0x03, 0x55, 0x1d, 0x23,
  0x04, 0x18, 0x30, 0x16, 0x80, 0x14, 0x4b, 0xec, 0xf9, 0x1a, 0xe9, 0x3a,
  0xa9, 0xbf, 0x83, 0x40, 0x7b, 0x3f, 0xe0, 0x29, 0x86, 0xbd, 0x37, 0x38,
  0x57, 0x90, 0x30, 0x0f, 0x06, 0x03, 0x55, 0x1d, 0x13, 0x01, 0x01, 0xff,
  0x04, 0x05, 0x30, 0x03, 0x01, 0x01, 0xff, 0x30, 0x0d, 0x06, 0x09, 0x2a,
  0x86, 0x48, 0x86, 0xf7, 0x0d, 0x01, 0x01, 0x0b, 0x05, 0x00, 0x03, 0x82,
  0x01, 0x01, 0x00, 0x16, 0x2d, 0x8c, 0x82, 0x82, 0xb4, 0x4d, 0x8a, 0x3a,
  0x83, 0x79, 0xd9, 0x41, 0x29, 0x37, 0xcd, 0x90, 0xc5, 0xd5, 0x22, 0x03,
  0x3f, 0x0e, 0x29, 0xd5, 0xfa, 0xfa, 0x8f, 0x60, 0xea, 0xe3, 0x77, 0x5f,
  0xf3, 0x3c, 0x2a, 0x63, 0xeb, 0x49, 0x8f, 0x3b, 0xef, 0x40, 0x2d, 0xdf,
  0x40, 0x43, 0x52, 0xb6, 0xa2, 0x4d, 0xcc, 0xea, 0x37, 0x65, 0x6b, 0xd7,
  0x1c, 0x78, 0xc1, 0x0f, 0x99, 0x21, 0x28, 0x0b, 0xd8, 0x43, 0x23, 0x68,
  0xb7, 0x71, 0xf9, 0xc2, 0x23, 0x65, 0xb2, 0xab, 0x08, 0x03, 0x60, 0x1e,
  0x18, 0xa9, 0xd3, 0x63, 0x8b, 0x33, 0x55, 0x89, 0xcd, 0x5b, 0x65, 0x82,
  0x13, 0xbc, 0xea, 0x6d, 0x0d, 0x85, 0x54, 0x68, 0x50, 0x0a, 0xe7, 0xde,
  0x6b, 0xde, 0xc9, 0xee, 0x00, 0x1b, 0x8b, 0xa9, 0xb2, 0xdd, 0x58, 0x49,
  0x45, 0x2d, 0x59, 0xcc, 0xbe, 0x7e, 0xea, 0x99, 0xd3, 0x85, 0x09, 0x99,
  0x5d, 0xcd, 0x1b, 0xb8, 0x7b, 0x90, 0xb9, 0xf4, 0xbd, 0x2c, 0x95, 0x9f,
  0xc5, 0xec, 0xe9, 0xfc, 0xda, 0xc6, 0x35, 0x54, 0x47, 0x64, 0xc2, 0xe5,
  0x85, 0x9d, 0x04, 0xc7, 0xd8, 0x65, 0x21, 0x8e, 0x58, 0x58, 0x97, 0xdb,
  0x3e, 0x5f, 0x37, 0xa4, 0x24, 0xe4, 0x55, 0x85, 0x1b, 0x54, 0xbb, 0x43,
  0x49, 0xf5, 0xa8, 0x65, 0x74, 0x71, 0x37, 0x32, 0x75, 0xb3, 0xf8, 0xae,
  0xbd, 0xc4, 0x61, 0xd8, 0xa4, 0xc4, 0x15, 0x9d, 0x37, 0xf3, 0xf2, 0x62,
  0xb2, 0xd7, 0x26, 0xc4, 0x3c, 0x11, 0xf7, 0xef, 0x9c, 0x7a, 0xb7, 0x6c,
  0xf1, 0x44, 0x77, 0x8a, 0x11, 0xe3, 0xd1, 0x37, 0x2c, 0x3b, 0xc3, 0x99,
  0x4e, 0x22, 0x1d, 0xb0, 0xe0, 0xea, 0x8a, 0xdc, 0x0c, 0x96, 0x15, 0xe3,
  0x62, 0x19, 0x79, 0xf9, 0x3e, 0x3a, 0xfc, 0x61, 0x47, 0xee, 0x28, 0x20,
  0x17, 0xe3, 0xbb, 0x4d, 0xe5, 0x8e, 0xf2
};
static const unsigned int server_certificate_len = sizeof(server_certificate);

static const unsigned char private_key[] = {
  0x30, 0x82, 0x04, 0xa4, 0x02, 0x01, 0x00, 0x02, 0x82, 0x01, 0x01, 0x00,
  0xe8, 0xb5, 0x25, 0x89, 0xc4, 0xc1, 0x6f, 0x65, 0x7d, 0x02, 0xbc, 0xf8,
  0x12, 0xa8, 0xf6, 0x26, 0x54, 0xc3, 0x16, 0x74, 0xe8, 0x15, 0x54, 0x90,
  0x4b, 0x43, 0x18, 0x69, 0xa5, 0x2c, 0x3b, 0xe7, 0x27, 0xf6, 0x0a, 0x1e,
  0xf8, 0x05, 0x6d, 0x91, 0x5c, 0xc7, 0x80, 0xab, 0x9f, 0xf4, 0x1f, 0x79,
  0xb1, 0xf0, 0x01, 0xaf, 0x61, 0xdc, 0xaf, 0x29, 0x7e, 0x7e, 0x4f, 0x5d,
  0xe3, 0x3f, 0x1c, 0xba, 0xc7, 0x1c, 0x8f, 0xf4, 0xe9, 0x26, 0xbc, 0x8d,
  0x39, 0x86, 0x0b, 0xf9, 0x5c, 0xa9, 0xb6, 0xbf, 0xe8, 0x99, 0x91, 0xeb,
  0x64, 0xdd, 0xff, 0x01, 0x8e, 0x4e, 0xa5, 0x5a, 0xf5, 0x97, 0x15, 0x9d,
  0x73, 0x11, 0x93, 0xc7, 0x8b, 0xad, 0x09, 0x94, 0x4a, 0xf8, 0x40, 0xbc,
  0x44, 0x00, 0x68, 0xe1, 0xbf, 0x6a, 0x84, 0x7a, 0x11, 0x78, 0x80, 0x59,
  0x0d, 0x53, 0x83, 0x77, 0x7e, 0x62, 0x79, 0xe4, 0xdc, 0x5f, 0x61, 0xa9,
  0xa9, 0x3a, 0xd6, 0x64, 0xa0, 0xc0, 0x12, 0x4a, 0x4b, 0xfc, 0x12, 0x0d,
  0x61, 0x42, 0x2a, 0xc7, 0x47, 0xb3, 0x49, 0x8f, 0x73, 0xf3, 0xfb, 0xd3,
  0xd1, 0x59, 0xb3, 0x46, 0x29, 0x37, 0xc8, 0xc5, 0x14, 0x1c, 0x6e, 0xb8,
  0x0a, 0x87, 0x95, 0xff, 0xa4, 0x4a, 0x0e, 0x23, 0x48, 0xdf, 0xd6, 0x88,
  0x9c, 0xee, 0xfc, 0xf4, 0x2b, 0xcd, 0x93, 0x7f, 0x0e, 0xb7, 0xb9, 0x85,
  0x43, 0xf6, 0xc2, 0x8f, 0x75, 0xdd, 0xfe, 0x08, 0x72, 0x30, 0x2e, 0x27,
  0x5f, 0xbf, 0xf4, 0x2d, 0x6e, 0xaf, 0x17, 0x72, 0x85, 0x83, 0x0c, 0x2f,
  0x26, 0x48, 0x59, 0xa7, 0xae, 0xf7, 0xd8, 0xaf, 0xc0, 0x10, 0x25, 0xfd,
  0x02, 0x19, 0xef, 0x04, 0xfd, 0x27, 0xe3, 0xa0, 0xc2, 0xb1, 0xe4, 0x59,
  0x6c, 0x1a, 0x1d, 0xed, 0x41, 0x5c, 0x15, 0xd0, 0x56, 0xad, 0xad, 0x7d,
  0xf7, 0x9a, 0x6b, 0x73, 0x02, 0x03, 0x01, 0x00, 0x01, 0x02, 0x82, 0x01,
  0x00, 0x56, 0xb2, 0x9a, 0x84, 0x2b, 0xee, 0x47, 0x52, 0xdf, 0xd2, 0xc3,
  0xd5, 0x86, 0x9a, 0x35, 0x6e, 0xcd, 0x78, 0x8b, 0x66, 0xcd, 0xca, 0x98,
  0xa1, 0x53, 0xb0, 0xf1, 0x28, 0xf6, 0xf5, 0x36, 0x72, 0x26, 0x04, 0xb7,
  0xfb, 0x96, 0xba, 0xea, 0xf9, 0xd3, 0xbf, 0xae, 0x34, 0x02, 0xd9, 0x60,
  0x5a, 0xa6, 0x0c, 0xfd, 0x8b, 0xba, 0x61, 0x8e, 0x4e, 0xde, 0xc6, 0x2f,
  0x4a, 0x92, 0xee, 0x02, 0x05, 0xa2, 0x46, 0x05, 0x6a, 0x20, 0xed, 0x22,
  0x25, 0x59, 0x6f, 0x94, 0x09, 0x78, 0xd8, 0xef, 0xf1, 0xaa, 0xb6, 0x80,
  0x53, 0x5b, 0x56, 0x8b, 0xf9, 0xa7, 0xeb, 0xac, 0x16, 0x69, 0xd6, 0x3a,
  0xa2, 0xd8, 0xea, 0x8d, 0x0c, 0xb4, 0x80, 0xa8, 0xc7, 0x7b, 0x70, 0xe7,
  0x29, 0x5d, 0x0a, 0x6c, 0x08, 0xe3, 0x18, 0x4b, 0xb7, 0xf0, 0xc7, 0x5c,
  0xc6, 0x10, 0xbd, 0x73, 0x06, 0xf3, 0x6a, 0xbb, 0xef, 0x6e, 0xb0, 0x32,
  0x8c, 0x5a, 0x49, 0x70, 0xee, 0x9e, 0xce, 0xbd, 0x50, 0x5a, 0x9d, 0x35,
  0x93, 0x49, 0xc3, 0x99, 0x1b, 0x4f, 0xb6, 0xd7, 0x7a, 0xcd, 0xc4, 0x49,
  0xa3, 0x3e, 0x60, 0x91, 0xf4, 0x6a, 0x9f, 0x8f, 0xa4, 0x83, 0x93, 0xd3,
  0xd7, 0x7e, 0xe4, 0x40, 0x4b, 0x89, 0x1f, 0xd5, 0x31, 0xfd, 0xb4, 0x6f,
  0x9c, 0xf9, 0x2c, 0x45, 0x03, 0xe3, 0xd2, 0xf0, 0x7b, 0x50, 0x6e, 0xa4,
  0x96, 0xa0, 0x7d, 0xa1, 0xa3, 0x32, 0xa1, 0xb1, 0x44, 0x6e, 0xf4, 0xb2,
  0xa8, 0xa4, 0x29, 0xe6, 0xf2, 0x96, 0xcf, 0xe0, 0x93, 0x2c, 0xc2, 0xc9,
  0xc3, 0xea, 0xa4, 0xfd, 0xdc, 0x17, 0xbd, 0x69, 0xe5, 0x22, 0x5e, 0x8d,
  0x8c, 0xcc, 0xed, 0x8a, 0xc0, 0x92, 0xc4, 0x1c, 0xed, 0xe8, 0x53, 0xb9,
  0xab, 0x7d, 0x99, 0x81, 0x4b, 0x00, 0x03, 0x1c, 0xaf, 0xca, 0xa9, 0xe3,
  0xff, 0x41, 0xb9, 0xdd, 0x29, 0x02, 0x81, 0x81, 0x00, 0xfa, 0x37, 0x03,
  0xf8, 0x2b, 0x56, 0x24, 0x79, 0x2f, 0x74, 0x1d, 0x01, 0xda, 0x6b, 0xbf,
  0x2c, 0xa2, 0x62, 0x80, 0xb7, 0x49, 0x50, 0xdc, 0xee, 0x7f, 0x4c, 0x78,
  0x07, 0x28, 0x7c, 0xc0, 0x99, 0xe4, 0x71, 0xea, 0x41, 0xae, 0xc9, 0x06,
  0xfd, 0x21, 0x05, 0x89, 0xb9, 0xc9, 0xf3, 0xb5, 0x37, 0xc1, 0x58, 0xed,
  0xf9, 0x62, 0xe4, 0x0e, 0xd0, 0x9e, 0x55, 0x08, 0x92, 0xbc, 0x86, 0xbd,
  0x93, 0xcf, 0x74, 0xfd, 0xd0, 0xe4, 0x24, 0x47, 0x0c, 0x87, 0xd3, 0x9d,
  0xf8, 0xb3, 0xdf, 0x04, 0x8c, 0xbc, 0x96, 0xcf, 0x92, 0x5a, 0x04, 0x27,
  0x0b, 0x80, 0x84, 0x8e, 0xba, 0x59, 0x79, 0xd7, 0xb2, 0x31, 0xaf, 0xb9,
  0x00, 0x5c, 0xa3, 0x27, 0x98, 0x91, 0x92, 0x92, 0x92, 0x34, 0x1a, 0x23,
  0x17, 0xb8, 0xbe, 0x54, 0x33, 0xbe, 0xcd, 0x5c, 0xc6, 0xe0, 0x9d, 0x0f,
  0xb8, 0x6e, 0xc6, 0x1c, 0xc9, 0x02, 0x81, 0x81, 0x00, 0xee, 0x16, 0x82,
  0x0f, 0x1c, 0x8b, 0x81, 0x26, 0x3f, 0xb1, 0xeb, 0xb2, 0xf0, 0x06, 0x43,
  0xa8, 0xcd, 0x04, 0xcd, 0x71, 0xaf, 0xd7, 0x85, 0x54, 0x45, 0xec, 0xf7,
  0x72, 0x0c, 0xf2, 0x65, 0x6c, 0x4a, 0x44, 0x64, 0x03, 0xab, 0x31, 0x3d,
  0xd9, 0xcd, 0x8a, 0xed, 0x31, 0x73, 0x52, 0x35, 0x30, 0xa2, 0x9c, 0x19,
  0x96, 0x42, 0x4b, 0xff, 0x13, 0x44, 0x2c, 0x8d, 0x2f, 0x67, 0x35, 0x59,
  0xcf, 0x5b, 0xa5, 0x1b, 0x1d, 0x30, 0xe2, 0x71, 0x96, 0xf3, 0x59, 0xd0,
  0xa4, 0xde, 0x10, 0x33, 0x30, 0xf9, 0x1d, 0x08, 0x12, 0x05, 0x6d, 0x13,
  0x76, 0xbc, 0x0d, 0x10, 0xa7, 0xa0, 0x13, 0x3c, 0x93, 0x17, 0x73, 0xab,
  0xd8, 0x23, 0x88, 0xa8, 0xa6, 0x51, 0x0f, 0x6b, 0x67, 0x9c, 0x89, 0x3b,
  0xce, 0x11, 0x2f, 0xb0, 0xbe, 0xa8, 0xf7, 0x92, 0xb6, 0x0a, 0x88, 0x22,
  0x95, 0xce, 0x44, 0xb0, 0x5b, 0x02, 0x81, 0x80, 0x7e, 0xcb, 0x06, 0x2d,
  0xe9, 0xf7, 0xfa, 0xff, 0x95, 0xf6, 0x67, 0x04, 0x9b, 0x64, 0x62, 0x3a,
  0x02, 0x07, 0x9c, 0x66, 0x44, 0xb6, 0xbf, 0x5d, 0xf4, 0x10, 0x11, 0xfa,
  0xbe, 0x9f, 0x89, 0x11, 0xf2, 0xdb, 0x6e, 0xf3, 0xdd, 0xd8, 0x6c, 0xbc,
  0x34, 0xd1, 0x93, 0x9b, 0x1c, 0x25, 0x6d, 0x3d, 0x55, 0xb2, 0xf4, 0xd4,
  0x9d, 0x32, 0x27, 0xf7, 0xbb, 0x64, 0x27, 0xb6, 0x03, 0xe6, 0xdb, 0x86,
  0x5d, 0x68, 0x51, 0x7e, 0x5b, 0x3d, 0xae, 0xeb, 0x40, 0xa1, 0x11, 0xba,
  0x07, 0x9c, 0x09, 0xb8, 0x2f, 0x90, 0xd4, 0x9a, 0xbb, 0x16, 0xc3, 0x9a,
  0x66, 0x83, 0xc5, 0xb7, 0xd4, 0xc3, 0x93, 0x73, 0xef, 0x0d, 0xb6, 0xd7,
  0xe2, 0x19, 0xa3, 0x65, 0x02, 0xcf, 0x9d, 0x8a, 0x8c, 0xf0, 0x79, 0xbb,
  0xf9, 0x98, 0x29, 0x1f, 0x17, 0x9f, 0x05, 0x56, 0x9a, 0x57, 0xbc, 0xb1,
  0x9f, 0x20, 0xb1, 0x51, 0x02, 0x81, 0x81, 0x00, 0xc8, 0x68, 0x5f, 0xcf,
  0xd2, 0x8a, 0x47, 0x0a, 0xe8, 0x20, 0x9e, 0xb2, 0xbf, 0x41, 0xb6, 0xa0,
  0x16, 0xfb, 0x0c, 0xe7, 0xbe, 0x49, 0x1e, 0xec, 0xc1, 0xf3, 0x66, 0x92,
  0x34, 0xfd, 0xb0, 0x8b, 0xc7, 0xb3, 0xeb, 0xaf, 0xfe, 0xe0, 0xf3, 0x1c,
  0x2b, 0xdc, 0xde, 0x2d, 0x7a, 0xd1, 0xde, 0xfd, 0xf2, 0x52, 0x8d, 0x63,
  0x22, 0xa9, 0x0f, 0xab, 0xaa, 0xfe, 0x09, 0x55, 0xb6, 0x7d, 0x7c, 0xfc,
  0x83, 0x3a, 0xe6, 0x28, 0xdb, 0x26, 0x30, 0xd1, 0x0c, 0x44, 0x34, 0xd1,
  0x22, 0x2e, 0xe6, 0xb8, 0x39, 0x68, 0xcb, 0x8b, 0x47, 0xcf, 0xf9, 0xcb,
  0x3f, 0x1d, 0x8c, 0x40, 0x5d, 0x08, 0xf4, 0x3b, 0x28, 0x49, 0x70, 0x83,
  0xfd, 0xdd, 0x21, 0x80, 0xe5, 0xc8, 0xa1, 0xf2, 0xd4, 0x1b, 0xdc, 0x20,
  0x67, 0xed, 0x09, 0xcc, 0x63, 0x34, 0x09, 0xe5, 0x7b, 0xd5, 0xfd, 0xae,
  0xb5, 0xb2, 0xb1, 0xf3, 0x02, 0x81, 0x81, 0x00, 0xc2, 0x67, 0x93, 0x68,
  0x31, 0xd4, 0x71, 0x7f, 0x1c, 0x24, 0xec, 0x9b, 0x2a, 0x3d, 0x43, 0x0f,
  0xd0, 0x3c, 0xe4, 0xd2, 0x2d, 0xf8, 0xe7, 0xf0, 0x8e, 0x56, 0x8d, 0xcb,
  0x5a, 0x68, 0x74, 0xf9, 0xba, 0xaa, 0x75, 0x76, 0x4f, 0x53, 0x93, 0xd1,
  0xcf, 0x96, 0x72, 0x2c, 0x87, 0x1d, 0xc3, 0xaf, 0x9b, 0xe8, 0x3f, 0x48,
  0x5b, 0xac, 0x35, 0xed, 0x5e, 0x24, 0x87, 0xa8, 0xc3, 0x9a, 0x94, 0xbe,
  0x60, 0x50, 0xaf, 0x89, 0xdb, 0x8f, 0x01, 0xd9, 0x1c, 0x98, 0x11, 0xb6,
  0x51, 0x59, 0x26, 0x50, 0x6e, 0x3f, 0x09, 0xf3, 0x61, 0xf6, 0x2e, 0xf0,
  0xe3, 0xd6, 0xdd, 0x86, 0x7c, 0xb6, 0x7f, 0x14, 0xfc, 0x9e, 0x17, 0x4d,
  0x03, 0x3e, 0x60, 0x32, 0x5c, 0x52, 0x99, 0xc2, 0x26, 0x12, 0xa7, 0x57,
  0x96, 0xe9, 0x6c, 0x95, 0x38, 0x50, 0x95, 0x44, 0xe1, 0x01, 0x9f, 0x0b,
  0x14, 0x8c, 0xc9, 0xa8
};
static const unsigned int private_key_len = sizeof(private_key);
```
